## config/boards/shields/charybdis/Kconfig.defconfig
```kconfig
# Copyright (c) 2022 Duccio Breschi
# SPDX-License-Identifier: MIT

if SHIELD_CHARYBDIS_RIGHT

config ZMK_KEYBOARD_NAME
    default "CHARYBDIS"

config ZMK_SPLIT_ROLE_CENTRAL
    default y

endif

if SHIELD_CHARYBDIS_LEFT || SHIELD_CHARYBDIS_RIGHT

config ZMK_SPLIT
    default y

endif
```

## config/boards/shields/hatsu/Kconfig.defconfig
```kconfig
# Copyright (c) 2022 Duccio Breschi
# SPDX-License-Identifier: MIT

if SHIELD_HATSU_RIGHT

config ZMK_KEYBOARD_NAME
    default "HATSU"

config ZMK_SPLIT_ROLE_CENTRAL
    default y

endif

if SHIELD_HATSU_LEFT || SHIELD_HATSU_RIGHT

config ZMK_SPLIT
    default y

endif
```

## config/boards/shields/hatsu/Kconfig.shield
```kconfig
# Copyright (c) 2022 Duccio Breschi
# SPDX-License-Identifier: MIT

config SHIELD_HATSU_LEFT
    def_bool $(shields_list_contains,hatsu_left)

config SHIELD_HATSU_RIGHT
    def_bool $(shields_list_contains,hatsu_right)
```
